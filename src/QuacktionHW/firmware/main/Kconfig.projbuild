## src/QuacktionHW/firmware/main/Kconfig.projbuild
```kconfig
menu "Quacktion"

    config QUACK_WIFI_SSID
        string "Wi-Fi SSID"
        default ""
        help
            Development fallback. Leave empty in committed configs.

    config QUACK_WIFI_PASSWORD
        string "Wi-Fi password"
        default ""
        help
            Development fallback. Leave empty in committed configs.

    config QUACK_BACKEND_URL
        string "Backend base URL"
        default ""
        help
            Base URL of the Quacktion backend, for example https://api.example.com.
            Plain http is for local development only.

    config QUACK_DEVICE_ID
        string "Device ID"
        default ""
        help
            Backend-assigned device ID. Development fallback.

    config QUACK_DEVICE_CREDENTIAL
        string "Device credential"
        default ""
        help
            Device credential returned by pairing. Development fallback.
            Never commit a real value.

    config QUACK_SESSION_IDLE_SECONDS
        int "End a conversation after this many seconds of quiet"
        default 10
        range 3 120
        help
            The session ends when nobody has spoken and no reply has played for this long.

    config QUACK_SPEECH_MIN_DB
        int "Minimum speech level that keeps a conversation open (dBFS)"
        default -42
        range -70 0
        help
            Speech quieter than this, such as people talking further away, does not count as
            someone talking to the duck.

    config QUACK_SESSION_MAX_SECONDS
        int "Maximum conversation length in seconds"
        default 300
        range 30 3600

endmenu
```

## src/QuacktionHW/firmware/sdkconfig.defaults
```kconfig
CONFIG_IDF_TARGET="esp32s3"
CONFIG_ESPTOOLPY_FLASHSIZE_16MB=y
CONFIG_ESPTOOLPY_FLASHMODE_QIO=y
CONFIG_ESPTOOLPY_FLASHFREQ_80M=y
CONFIG_PARTITION_TABLE_CUSTOM=y
CONFIG_PARTITION_TABLE_CUSTOM_FILENAME="partitions.csv"
CONFIG_ESP_DEFAULT_CPU_FREQ_MHZ_240=y

CONFIG_SPIRAM=y
CONFIG_SPIRAM_MODE_OCT=y
CONFIG_SPIRAM_SPEED_80M=y
CONFIG_SPIRAM_USE_MALLOC=y
CONFIG_SPIRAM_MALLOC_ALWAYSINTERNAL=1024
CONFIG_SPIRAM_MALLOC_RESERVE_INTERNAL=32768

CONFIG_ESP32S3_DATA_CACHE_64KB=y
CONFIG_ESP32S3_DATA_CACHE_LINE_64B=y

CONFIG_ESP_CONSOLE_UART_DEFAULT=y
CONFIG_ESP_MAIN_TASK_STACK_SIZE=8192

CONFIG_MBEDTLS_EXTERNAL_MEM_ALLOC=y
CONFIG_SPIRAM_TRY_ALLOCATE_WIFI_LWIP=y
CONFIG_MBEDTLS_CERTIFICATE_BUNDLE=y
CONFIG_MBEDTLS_CERTIFICATE_BUNDLE_DEFAULT_FULL=y

CONFIG_MODEL_IN_FLASH=y
CONFIG_SR_WN_WN9_HIESP=y
CONFIG_SR_VADN_VADNET1_MEDIUM=y

CONFIG_BT_ENABLED=y
CONFIG_BT_NIMBLE_ENABLED=y
CONFIG_BT_NIMBLE_MAX_CONNECTIONS=1
# CONFIG_BT_NIMBLE_ROLE_CENTRAL is not set
# CONFIG_BT_NIMBLE_ROLE_OBSERVER is not set
CONFIG_BT_NIMBLE_MEM_ALLOC_MODE_EXTERNAL=y
CONFIG_BT_NIMBLE_ATT_PREFERRED_MTU=517
# CONFIG_ESP_PROTOCOMM_SUPPORT_SECURITY_VERSION_0 is not set
# CONFIG_ESP_PROTOCOMM_SUPPORT_SECURITY_VERSION_1 is not set
CONFIG_ESP_PROTOCOMM_SUPPORT_SECURITY_VERSION_2=y

CONFIG_ESP_WIFI_DPP_SUPPORT=y
```
